## conf/layer.conf
```bitbake
# We have a conf and classes directory, add to BBPATH
BBPATH .= ":${LAYERDIR}"

# We have recipes-* directories, add to BBFILES
BBFILES += "${LAYERDIR}/recipes-*/*/*.bb \
            ${LAYERDIR}/recipes-*/*/*.bbappend"

BBFILE_COLLECTIONS += "meta-thomux-odroid"
BBFILE_PATTERN_meta-thomux-odroid = "^${LAYERDIR}/"
BBFILE_PRIORITY_meta-thomux-odroid = "6"

LAYERDEPENDS_meta-thomux-odroid = "core"
LAYERSERIES_COMPAT_meta-thomux-odroid = "honister"
```
